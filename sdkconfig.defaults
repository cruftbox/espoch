## sdkconfig.defaults
```kconfig
# ESPoch — sdkconfig defaults for Waveshare ESP32-S3-Touch-AMOLED-2.06
#
# These are applied on first build (idf.py set-target esp32s3).
# Any value can be overridden by running: idf.py menuconfig

# --- Chip ---
CONFIG_IDF_TARGET="esp32s3"

# --- Flash ---
# 32 MB QIO flash on this board
CONFIG_ESPTOOLPY_FLASHSIZE_32MB=y
CONFIG_ESPTOOLPY_FLASHMODE_QIO=y
CONFIG_ESPTOOLPY_FLASHFREQ_80M=y

# --- PSRAM ---
# 8 MB Octal PSRAM (ESP32-S3R8). FETCH_INSTRUCTIONS + RODATA (XIP from PSRAM)
# and the 64-byte data cache line give the display's QSPI DMA enough memory
# bandwidth to feed the panel — without these the screen flush hits
# "DMA TX underflow". These mirror Waveshare's working demo config.
CONFIG_SPIRAM=y
CONFIG_SPIRAM_MODE_OCT=y
CONFIG_SPIRAM_SPEED_80M=y
CONFIG_SPIRAM_FETCH_INSTRUCTIONS=y
CONFIG_SPIRAM_RODATA=y
CONFIG_ESP32S3_DATA_CACHE_LINE_64B=y

# --- CPU ---
CONFIG_ESP32S3_DEFAULT_CPU_FREQ_240=y

# --- Compiler ---
# Optimize for performance (helps display throughput / frame rate).
CONFIG_COMPILER_OPTIMIZATION_PERF=y

# --- USB ---
# Use the onboard USB-Serial-JTAG for flashing and console
CONFIG_ESP_CONSOLE_USB_SERIAL_JTAG=y

# --- Logging ---
CONFIG_LOG_DEFAULT_LEVEL_INFO=y

# --- FreeRTOS ---
CONFIG_FREERTOS_HZ=1000

# --- Bluetooth ---
# Enabled — needed for Stage 5 (ANCS + AMS with iPhone over BLE)
CONFIG_BT_ENABLED=y
CONFIG_BT_NIMBLE_ENABLED=y

# --- WiFi ---
# Enabled — needed for Stage 3 (NTP + OTA + web config)
CONFIG_ESP_WIFI_ENABLED=y

# --- Partition table ---
# LVGL + the BSP make the app too big for the default 1 MB factory slot.
# Use the large single-app layout for now. Stage 3 will switch to a
# two-slot OTA partition table.
CONFIG_PARTITION_TABLE_SINGLE_APP_LARGE=y

# --- LVGL performance (from Waveshare's demo) ---
# Use the C library allocator/string/sprintf, run LVGL on FreeRTOS, place hot
# code in IRAM, and refresh ~every 15 ms — the combination Waveshare ships.
CONFIG_LV_USE_CLIB_MALLOC=y
CONFIG_LV_USE_CLIB_STRING=y
CONFIG_LV_USE_CLIB_SPRINTF=y
CONFIG_LV_OS_FREERTOS=y
CONFIG_LV_DEF_REFR_PERIOD=15
CONFIG_LV_DRAW_SW_DRAW_UNIT_CNT=2
# NOTE: CONFIG_LV_ATTRIBUTE_FAST_MEM_USE_IRAM is intentionally NOT set — it
# triggers a conflicting-section-attribute error under GCC 15 (ESP-IDF v6).

# --- LVGL fonts for the watch face (Stage 2) ---
# Built-in Montserrat sizes used by the dashboard layout.
CONFIG_LV_FONT_MONTSERRAT_20=y
CONFIG_LV_FONT_MONTSERRAT_28=y
CONFIG_LV_FONT_MONTSERRAT_48=y
```
